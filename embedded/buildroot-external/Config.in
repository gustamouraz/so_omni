## embedded/buildroot-external/Config.in
```kconfig
menu "SO Omni"
source "$BR2_EXTERNAL_OMNI_PATH/package/omni-core/Config.in"
endmenu
```

## embedded/buildroot-external/configs/omni_qemu_aarch64_defconfig
```kconfig
BR2_aarch64=y
BR2_PACKAGE_HOST_LINUX_HEADERS_CUSTOM_6_18=y
BR2_GLOBAL_PATCH_DIR="board/qemu/patches"
BR2_DOWNLOAD_FORCE_CHECK_HASHES=y
BR2_USE_WCHAR=y
BR2_TARGET_GENERIC_HOSTNAME="so-omni"
BR2_TARGET_GENERIC_ISSUE="SO Omni 0.2 - QEMU ARM64"
BR2_SYSTEM_DHCP="eth0"
BR2_ROOTFS_OVERLAY="$(BR2_EXTERNAL_OMNI_PATH)/board/omni/rootfs-overlay"
BR2_ROOTFS_DEVICE_TABLE="system/device_table_dev.txt $(BR2_EXTERNAL_OMNI_PATH)/board/omni/device_table.txt"
BR2_ROOTFS_POST_IMAGE_SCRIPT="$(BR2_EXTERNAL_OMNI_PATH)/board/omni/post-image.sh"
BR2_ROOTFS_POST_SCRIPT_ARGS="$(BR2_DEFCONFIG)"
BR2_LINUX_KERNEL=y
BR2_LINUX_KERNEL_CUSTOM_VERSION=y
BR2_LINUX_KERNEL_CUSTOM_VERSION_VALUE="6.18.7"
BR2_LINUX_KERNEL_USE_CUSTOM_CONFIG=y
BR2_LINUX_KERNEL_CUSTOM_CONFIG_FILE="board/qemu/aarch64-virt/linux.config"
BR2_LINUX_KERNEL_NEEDS_HOST_OPENSSL=y
BR2_PACKAGE_DBUS=y
BR2_PACKAGE_CONNMAN=y
BR2_PACKAGE_CONNMAN_WIFI=y
BR2_PACKAGE_CONNMAN_BLUETOOTH=y
BR2_PACKAGE_CONNMAN_CLIENT=y
BR2_PACKAGE_WPA_SUPPLICANT=y
BR2_PACKAGE_WPA_SUPPLICANT_DBUS=y
BR2_PACKAGE_BLUEZ5_UTILS=y
BR2_PACKAGE_BLUEZ5_UTILS_CLIENT=y
BR2_PACKAGE_BLUEZ5_UTILS_PLUGINS_AUDIO=y
BR2_PACKAGE_BLUEZ5_UTILS_PLUGINS_NETWORK=y
BR2_PACKAGE_ALSA_UTILS=y
BR2_PACKAGE_GPSD=y
BR2_PACKAGE_OMNI_CORE=y
BR2_TARGET_ROOTFS_EXT2=y
BR2_TARGET_ROOTFS_EXT2_4=y
BR2_TARGET_ROOTFS_EXT2_SIZE="256M"
# BR2_TARGET_ROOTFS_TAR is not set
BR2_PACKAGE_HOST_QEMU=y
BR2_PACKAGE_HOST_QEMU_SYSTEM_MODE=y
```

## embedded/buildroot-external/package/omni-core/Config.in
```kconfig
config BR2_PACKAGE_OMNI_CORE
	bool "omni-core"
	depends on BR2_USE_MMU
	help
	  Lightweight state and safety-rules process for the SO Omni head unit.
```
